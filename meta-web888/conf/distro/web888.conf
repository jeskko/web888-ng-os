## meta-web888/conf/layer.conf
```bitbake
# SPDX-License-Identifier: GPL-3.0-or-later
BBPATH .= ":${LAYERDIR}"
BBFILES += "${LAYERDIR}/recipes-*/*/*.bb ${LAYERDIR}/recipes-*/*/*.bbappend"

BBFILE_COLLECTIONS += "web888"
BBFILE_PATTERN_web888 = "^${LAYERDIR}/"
BBFILE_PRIORITY_web888 = "10"

LAYERDEPENDS_web888 = "core xilinx"
LAYERSERIES_COMPAT_web888 = "wrynose"
```
